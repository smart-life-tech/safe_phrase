## wake/sdkconfig.defaults
```kconfig
CONFIG_ESP32_DEFAULT_CPU_FREQ_240=y
CONFIG_ESP_CONSOLE_UART_DEFAULT=y
CONFIG_ESP_MAIN_TASK_STACK_SIZE=8192
CONFIG_ESP_SR_WAKENET_ENABLE=y
CONFIG_ESP_SR_WAKENET_MODEL_WN9=y
CONFIG_ESP32_SPIRAM_SUPPORT=y
CONFIG_I2S_ISR_IRAM_SAFE=y
CONFIG_I2S_ENABLE_DEBUG_LOG=n
CONFIG_SR_WN_WN9_HI_LEXIN=y
CONFIG_SPIRAM=y
CONFIG_SPIRAM_USE_MALLOC=y
CONFIG_SPIRAM_CACHE_WORKAROUND=y
CONFIG_BOARD_HAS_PSRAM=y
```
